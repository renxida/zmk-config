/* source keypos definitions */
#include "zmk-helpers/key-labels/34.h"

/* activate bluetooth */
#define CONFIG_WIRELESS 1

#ifndef LH2
#define LH2
#endif

#ifndef RH2
#define RH2
#endif
/* source the main keymap */
#include "base.keymap"

/* use default transform for cradio */
/ { chosen { zmk,matrix_transform = &default_transform; }; };